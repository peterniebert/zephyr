## west.yml
```yaml
# The west manifest file for upstream Zephyr.
#
# The per-installation west configuration file, .west/config, sets the
# path to the project containing this file in the [manifest] section's
# "path" variable.
#
# You are free to create your own manifest files and put them in any
# repository you want, to create your own custom Zephyr installations.
# For example, you could create a manifest file in your own out of
# tree application directory, which would pull this zephyr repository
# in as an ordinary project.
#
# You can pass your manifest repositories to west init when creating a
# new Zephyr installation. See the west documentation for more
# information.

manifest:
  defaults:
    remote: upstream

  remotes:
    - name: upstream
      url-base: https://github.com/zephyrproject-rtos

  #
  # Please add items below based on alphabetical order
  projects:
    - name: canopennode
      revision: 53d3415c14d60f8f4bfca54bfbc5d5a667d7e724
      path: modules/lib/canopennode
    - name: chre
      revision: ef76d3456db07e4959df555047d6962279528c8d
      path: modules/lib/chre
    - name: edtt
      revision: 1ea61a390d2bfcf3b2ecdba8f8b0b98dfdffbd11
      path: tools/edtt
      groups:
        - tools
    - name: fatfs
      revision: a30531af3a95a9a3ea7d771ea8a578ebfed45514
      path: modules/fs/fatfs
      groups:
        - fs
    - name: hal_espressif
      revision: 8c7ee781ea4c4a010740f5231709ce7b21ad96d6
      path: modules/hal/espressif
      west-commands: west/west-commands.yml
      groups:
        - hal
    - name: hal_xtensa
      revision: 63f655362423aa49507da7977a2d37142e8debeb
      path: modules/hal/xtensa
      groups:
        - hal
    - name: libmetal
      revision: 2f586b4f1276fb075ee145421bdf6cbe5403aa41
      path: modules/hal/libmetal
      groups:
        - hal
    - name: liblc3
      revision: 448f3de31f49a838988a162ef1e23a89ddf2d2ed
      path: modules/lib/liblc3
    - name: littlefs
      path: modules/fs/littlefs
      groups:
        - fs
      revision: ca583fd297ceb48bced3c2548600dc615d67af24
    - name: loramac-node
      revision: ce57712f3e426bbbb13acaec97b45369f716f43a
      path: modules/lib/loramac-node
    - name: lvgl
      revision: 5ab83099854719ed326b6ecb9b09b07b1eee4818
      path: modules/lib/gui/lvgl
    - name: lz4
      revision: 8e303c264fc21c2116dc612658003a22e933124d
      path: modules/lib/lz4
    - name: mbedtls
      revision: 7fed49c9b9f983ad6416986661ef637459723bcb
      path: modules/crypto/mbedtls
      groups:
        - crypto
    - name: mcuboot
      revision: cfec947e0f8be686d02c73104a3b1ad0b5dcf1e6
      path: bootloader/mcuboot
    - name: mipi-sys-t
      path: modules/debug/mipi-sys-t
      groups:
        - debug
      revision: 0d521d8055f3b2b4842f728b0365d3f0ece9c37f
    - name: nanopb
      revision: dc4deed54fd4c7e1935e3b6387eedf21bb45dc38
      path: modules/lib/nanopb
    - name: net-tools
      revision: e0828aa9629b533644dc96ff6d1295c939bd713c
      path: tools/net-tools
      groups:
        - tools
    - name: open-amp
      revision: 8d53544871e1f300c478224faca6be8384ab0d04
      path: modules/lib/open-amp
    - name: openthread
      revision: bacf8d625f50dd5c4b415caee754c934ba1a262c
      path: modules/lib/openthread
    - name: picolibc
      path: modules/lib/picolibc
      revision: 04ada5951cbaf8e7b17f8226ce31cb6837c28ba7
    - name: segger
      revision: d4e568a920b4bd087886170a5624c167b2d0665e
      path: modules/debug/segger
      groups:
        - debug
    - name: sof
      revision: 9b564ea205b9597d29971cac0b5dcd9312db84d4
      path: modules/audio/sof
    - name: tflite-micro
      revision: 9156d050927012da87079064db59d07f03b8baf6
      path: modules/lib/tflite-micro
      repo-path: tflite-micro
    - name: tinycbor
      revision: 9e1f34bc08123aaad7666d3652aaa839e8178b3b
      path: modules/lib/tinycbor
    - name: tinycrypt
      revision: 3e9a49d2672ec01435ffbf0d788db6d95ef28de0
      path: modules/crypto/tinycrypt
      groups:
        - crypto
    - name: uoscore-uedhoc
      revision: e8920192b66db4f909eb9cd3f155d5245c1ae825
      path: modules/lib/uoscore-uedhoc
    - name: zcbor
      revision: 0.6.0
      path: modules/lib/zcbor
    - name: zscilib
      path: modules/lib/zscilib
      revision: ca070ddabdaf67175a2da901d0bd62e8899371c5

  self:
    path: zephyr
    west-commands: scripts/west-commands.yml
    import: submanifests
```
